## app/boards/arm/mikoto/Kconfig.defconfig
```kconfig
# Copyright (c) 2020 The ZMK Contributors
# SPDX-License-Identifier: MIT

if BOARD_MIKOTO

config BOARD
    default "mikoto"

if USB_DEVICE_STACK

config USB_NRFX
    default y

endif # USB_DEVICE_STACK

config BT_CTLR
    default BT

choice BOARD_MIKOTO_CHARGER_CURRENT
    default BOARD_MIKOTO_CHARGER_CURRENT_100MA
endchoice

endif # BOARD_MIKOTO
```
